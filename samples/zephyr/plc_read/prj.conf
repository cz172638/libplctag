## CMakeLists.txt
```
# SPDX-License-Identifier: MPL-2.0 OR LGPL-2.0-or-later
cmake_minimum_required(VERSION 3.20.0)

find_package(Zephyr REQUIRED HINTS $ENV{ZEPHYR_BASE})
project(plc_read)

target_sources(app PRIVATE src/main.c)
```

## Kconfig
```
# SPDX-License-Identifier: MPL-2.0 OR LGPL-2.0-or-later

mainmenu "libplctag plc_read sample"

config PLC_READ_GATEWAY
	string "PLC IP address"
	default "192.168.1.10"

config PLC_READ_PATH
	string "CIP route path (backplane,slot)"
	default "1,0"

config PLC_READ_PLC_TYPE
	string "libplctag plc= attribute"
	default "ControlLogix"

config PLC_READ_TAG_NAME
	string "Tag to read"
	default "TestDINTArray"

config PLC_READ_ELEM_COUNT
	int "Number of 32-bit elements"
	default 10

config PLC_READ_PERIOD_MS
	int "Read period in milliseconds (0 = back-to-back)"
	default 1000

config PLC_READ_ATTRS
	string "Full libplctag attribute string (overrides the options above)"
	default ""
	help
	  When set, used verbatim for plc_tag_create(), e.g.
	  "protocol=modbus-tcp&gateway=10.0.0.5:502&path=0&elem_count=10&name=hr0"
	  or "protocol=ab-eip&gateway=10.0.0.6&path=18,10.0.0.6&plc=omron-njnx&elem_size=4&elem_count=10&name=Arr".
	  Elements are read as 32-bit integers, except Modbus registers (16-bit).

config PLC_READ_DEBUG
	int "libplctag debug level (0-5)"
	default 1

config PLC_READ_TIMEOUT_MS
	int "Per-operation timeout in milliseconds"
	default 5000

source "Kconfig.zephyr"
```

## prj.conf
```kconfig
# libplctag
CONFIG_LIBPLCTAG=y

# networking
CONFIG_NETWORKING=y
CONFIG_NET_IPV4=y
CONFIG_NET_IPV6=n
CONFIG_NET_TCP=y
CONFIG_NET_SOCKETS=y
CONFIG_NET_SOCKETPAIR=y
CONFIG_NET_MAX_CONTEXTS=10
CONFIG_NET_MAX_CONN=10
CONFIG_ZVFS_OPEN_MAX=24
CONFIG_NET_PKT_RX_COUNT=32
CONFIG_NET_PKT_TX_COUNT=32
CONFIG_NET_BUF_RX_COUNT=64
CONFIG_NET_BUF_TX_COUNT=64
CONFIG_NET_TCP_MAX_RECV_WINDOW_SIZE=8192


# memory: libplctag thread stacks come from the kernel heap,
# tags/buffers from libc malloc
CONFIG_HEAP_MEM_POOL_SIZE=98304
CONFIG_MAIN_STACK_SIZE=8192
# tickler + refcount cleanup + one handler per PLC connection
CONFIG_POSIX_THREAD_THREADS_MAX=8
CONFIG_ENTROPY_GENERATOR=y

CONFIG_LOG=y
CONFIG_NET_LOG=y
CONFIG_PRINTK=y
```

## boards/native_sim_native_64.conf
```kconfig
# Host test: Zephyr sockets offloaded to the host Linux stack (NSOS),
# so the sample can talk to libplctag's ab_server on 127.0.0.1.
CONFIG_ETH_DRIVER=n
CONFIG_NET_L2_ETHERNET=n
CONFIG_NET_DRIVERS=y
CONFIG_NET_SOCKETS_OFFLOAD=y
CONFIG_NET_NATIVE_OFFLOADED_SOCKETS=y
CONFIG_HEAP_MEM_POOL_SIZE=262144
CONFIG_COMMON_LIBC_MALLOC_ARENA_SIZE=262144
```

## boards/waveshare_esp32p4_eth_esp32p4_hpcore.conf
```kconfig
# Waveshare ESP32-P4-ETH: on-chip EMAC + IP101 PHY, 32 MB PSRAM.
CONFIG_ETH_DRIVER=y
CONFIG_NET_L2_ETHERNET=y


# static IPv4 (or replace with CONFIG_NET_DHCPV4=y)
CONFIG_NET_CONFIG_SETTINGS=y
CONFIG_NET_CONFIG_NEED_IPV4=y
CONFIG_NET_CONFIG_MY_IPV4_ADDR="192.168.1.50"
CONFIG_NET_CONFIG_MY_IPV4_NETMASK="255.255.255.0"
CONFIG_NET_CONFIG_MY_IPV4_GW="192.168.1.1"
CONFIG_NET_CONFIG_INIT_TIMEOUT=10
```

## src/main.c
```c
/* SPDX-License-Identifier: MPL-2.0 OR LGPL-2.0-or-later */
/*
 * libplctag on Zephyr: read one DINT/REAL array tag in a loop and print
 * round-trip statistics.  This is the same access pattern as on Linux:
 * one array tag, Large Forward Open negotiated automatically by libplctag.
 */

#include <inttypes.h>
#include <stdbool.h>
#include <stdio.h>
#include <stdlib.h>
#include <string.h>

#include <zephyr/kernel.h>
#include <zephyr/sys/printk.h>
#include <zephyr/version.h>

#include <libplctag.h>

#define TAG_ATTRS                                                                  \
	"protocol=ab-eip&gateway=" CONFIG_PLC_READ_GATEWAY                         \
	"&path=" CONFIG_PLC_READ_PATH "&plc=" CONFIG_PLC_READ_PLC_TYPE             \
	"&elem_size=4&elem_count=" STRINGIFY(CONFIG_PLC_READ_ELEM_COUNT)            \
	"&name=" CONFIG_PLC_READ_TAG_NAME

#define STATS_EVERY 50

int main(void)
{
	int32_t tag;
	int rc;
	uint32_t n = 0, errors = 0;
	int64_t t_min = INT64_MAX, t_max = 0, t_sum = 0;

	printk("libplctag %d.%d.%d on Zephyr %s, board %s\n",
	       plc_tag_get_int_attribute(0, "version_major", 0),
	       plc_tag_get_int_attribute(0, "version_minor", 0),
	       plc_tag_get_int_attribute(0, "version_patch", 0),
	       KERNEL_VERSION_STRING, CONFIG_BOARD_TARGET);

	plc_tag_set_debug_level(CONFIG_PLC_READ_DEBUG);

	const char *attrs = sizeof(CONFIG_PLC_READ_ATTRS) > 1 ? CONFIG_PLC_READ_ATTRS : TAG_ATTRS;
	/* element width for printing: Modbus registers and PCCC N files are 16-bit */
	const char *es = strstr(attrs, "elem_size=");
	int esz = strstr(attrs, "modbus") ? 2 : (es ? atoi(es + 10) : 4);

	if (esz != 2 && esz != 4) {
		esz = 4;
	}

	printk("creating tag: %s\n", attrs);

	tag = plc_tag_create(attrs, CONFIG_PLC_READ_TIMEOUT_MS);
	if (tag < 0) {
		printk("plc_tag_create failed: %s\n", plc_tag_decode_error(tag));
		return 0;
	}

	printk("tag %d created, size %d bytes\n", tag, plc_tag_get_size(tag));

	while (1) {
		int64_t t0 = k_uptime_ticks();

		rc = plc_tag_read(tag, CONFIG_PLC_READ_TIMEOUT_MS);

		int64_t dt_us = k_ticks_to_us_near64(k_uptime_ticks() - t0);

		if (rc != PLCTAG_STATUS_OK) {
			errors++;
			printk("read #%u failed: %s\n", n, plc_tag_decode_error(rc));
		} else {
			t_min = MIN(t_min, dt_us);
			t_max = MAX(t_max, dt_us);
			t_sum += dt_us;
		}

		n++;

		if (n == 1 && rc == PLCTAG_STATUS_OK) {
			int cnt = MIN(plc_tag_get_size(tag) / esz, 8);

			printk("first read:");
			for (int i = 0; i < cnt; i++) {
				printk(" %" PRId32, esz == 2 ? (int32_t)plc_tag_get_int16(tag, i * 2)
							 : plc_tag_get_int32(tag, i * 4));
			}
			printk("%s\n", plc_tag_get_size(tag) / esz > 8 ? " ..." : "");
		}

		if ((n % STATS_EVERY) == 0) {
			uint32_t ok = n - errors;

			printk("reads %u errors %u  rtt us: min %" PRId64 " avg %" PRId64
			       " max %" PRId64 "\n",
			       n, errors, ok ? t_min : 0, ok ? t_sum / ok : 0, t_max);
		}

		if (CONFIG_PLC_READ_PERIOD_MS > 0) {
			k_msleep(CONFIG_PLC_READ_PERIOD_MS);
		}
	}

	return 0;
}
```
